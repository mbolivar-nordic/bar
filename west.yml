## west.yml
```yaml
manifest:
  group-filter: [-babblesim]
  import-group-filters: false
  self:
    west-commands: scripts/west-commands.yml
  projects:
    - name: zephyr
      url: https://github.com/mbolivar-nordic/zephyr
      revision: repro-jamie-import-group-filters
      import:
        # By using name-allowlist we can clone only the modules that are
        # strictly needed by the application.
        name-allowlist:
          - cmsis # required by the ARM port
          - hal_nordic # required by the custom_plank board (Nordic based)
          - hal_stm32 # required by the nucleo_f302r8 board (STM32 based)
          - bsim
```
